## practica2/src/Kconfig.projbuild
```kconfig
menu "Example Configuration"

    config ESP_WIFI_SSID_STA
        string "Station WiFi SSID"
        default "myssid"
        help
            SSID (network name) for the example to connect to.

    config ESP_WIFI_PASSWORD_STA
        string "Station WiFi Password"
        default "mypassword"
        help
            WiFi password (WPA or WPA2) for the example to use.

    config ESP_MAXIMUM_RETRY_STA
        int "Station Maximum retry"
        default 5
        help
            Set the Maximum retry to avoid station reconnecting to the AP unlimited when the AP is really inexistent.

    config ESP_WIFI_SSID_AP
        string "AP WiFi SSID"
        default "myssid"
        help
            SSID (network name) for the example to connect to.

    config ESP_WIFI_PASSWORD_AP
        string "AP WiFi Password"
        default "mypassword"
        help
            WiFi password (WPA or WPA2) for the example to use.
            
    config ESP_WIFI_CHANNEL_AP
        int "AP WiFi Channel"
        range 1 13
        default 1
        help
            WiFi channel (network channel) for the example to use.

    config ESP_MAX_STA_CONN_AP
        int "AP Maximal STA connections"
        default 4
        help
            Max number of the STA connects to AP.
endmenu
```
